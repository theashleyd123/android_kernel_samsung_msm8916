## arch/arm/configs/msm8916_sec_fortuna_chnzt_defconfig
```kconfig
CONFIG_SEC_FORTUNA_PROJECT=y
CONFIG_MACH_FORTUNA_CHN_ZT=y

# General setup
CONFIG_KERNEL_XZ=y
CONFIG_KERNEL_LZ4=n

#MTP
CONFIG_USB_ANDROID_SAMSUNG_MTP=n

# HARD RESET
CONFIG_RESTART_REASON_SEC_PARAM=y

# SS Pinctrl Driver
CONFIG_SEC_GPIO_SETTINGS=y

# MUIC
CONFIG_SM5502_MUIC=y
CONFIG_SM5504_MUIC=y
# CONFIG_MUIC_SM5502_SUPPORT_LANHUB_TA is not set
CONFIG_MUIC_SUPPORT_RUSTPROOF=y
CONFIG_USBID_STANDARD_VER_01=y

#Touch Screen
CONFIG_TOUCHSCREEN_IST30XX=y
CONFIG_TOUCHSCREEN_ZINITIX_BT541=y

#LCD
CONFIG_PANEL_HX8389C_GH9607501A_QHD=y
CONFIG_PANEL_S6D78A0_GH9607501A_QHD=y

# Charging/Battery
CONFIG_MFD_RT5033=y
CONFIG_MFD_RT5033_RESET_GPIO=n
CONFIG_MFD_RT5033_SLDO_VBUSDET=y
CONFIG_BATTERY_SAMSUNG=y
CONFIG_BATTERY_SAMSUNG_DATA_FILE="fortuna_battery_data.h"
CONFIG_SAMSUNG_LPM_MODE=y
CONFIG_CHARGER_RT5033=y
CONFIG_FUELGAUGE_RT5033=y
CONFIG_REGULATOR_RT5033=y
CONFIG_SIOP_CHARGING_LIMIT_CURRENT=1000

# VIBRATOR
CONFIG_VIBETONZ=y
CONFIG_TACTILE_ASSIST=y
CONFIG_MSM_VIBRATOR=y

#SENSOR
CONFIG_SENSORS=y
CONFIG_SENSORS_CORE=y
CONFIG_SENSORS_K2HH=y
CONFIG_SENSORS_K2HH_VDD=y
CONFIG_SENSORS_GP2A002=y
# CONFIG_SENSORS_HSCDTD008A is not set
#NFC
CONFIG_NFC_PN547=y
CONFIG_NFC_PN547_8916_USE_BBCLK2=y

#FLASH
CONFIG_FLASHLIGHT=y
CONFIG_RT_FLASH_LED=y
CONFIG_FLED_RT5033=y
CONFIG_FLED_RT5033_EXT_GPIO=y

#CAMERA
CONFIG_IMX219=y
CONFIG_S5K4ECGX=y
CONFIG_S5K5E3YX=y
CONFIG_S5K6A3YX=y
CONFIG_SR030PC50=y
CONFIG_SR130PC20=y
CONFIG_SR200PC20=y
CONFIG_SR544=y

# DUAL SIM / SINGLE SIM Detection
CONFIG_CHECK_SIMSLOT_COUNT=y
# CONFIG_CHECK_SIMSLOT_COUNT_GPIO is not set
CONFIG_CHECK_SIMSLOT_COUNT_DT=y

# MODEM SECURE CHECK
# CONFIG_SEC_PERIPHERAL_SECURE_CHK=y

#Wifi
#
# Enable Qualcomm Wifi features
#
CONFIG_MSM_PIL_PRONTO=y
CONFIG_WCNSS_CORE=y
CONFIG_WCNSS_CORE_PRONTO=y
CONFIG_WCNSS_MEM_PRE_ALLOC=y

#
# Wifi features (Qualcomm)
#
CONFIG_NET_CORE=y
CONFIG_WIRELESS=y
CONFIG_WIRELESS_EXT_SYSFS=y
CONFIG_WEXT_CORE=y
CONFIG_WEXT_PROC=y
CONFIG_CFG80211=y
CONFIG_CFG80211_DEFAULT_PS=y
#CONFIG_CFG80211_ALLOW_RECONNECT is not set
CONFIG_WLAN=y
CONFIG_WIRELESS_EXT=y
CONFIG_WEXT_PRIV=y
CONFIG_MODULES=y
CONFIG_MODULE_UNLOAD=y
CONFIG_MODULE_FORCE_UNLOAD=y
CONFIG_WCNSS_REGISTER_DUMP_ON_BITE =y

#APC CPR QUOTIENT
CONFIG_APC_CPR_QUOT_BOOST=y

# SDP
CONFIG_SDP=y
CONFIG_SDP_VAULT=y

#optimize mmc block delay on resume
CONFIG_MMC_BLOCK_DEFERRED_RESUME=y

# TIMA LOG
#CONFIG_ARCH_MSM8916_TIMA=y

# RTCC v3
CONFIG_SWAP=y
CONFIG_ZSMALLOC=y
CONFIG_ZRAM=y
CONFIG_RUNTIME_COMPCACHE=y
CONFIG_KSWAPD_NOSWAP=y
```
